## Linux_Kernel_Module/build/conf/bblayers.conf
```bitbake
# POKY_BBLAYERS_CONF_VERSION is increased each time build/conf/bblayers.conf
# changes incompatibly
POKY_BBLAYERS_CONF_VERSION = "2"

BBPATH = "${TOPDIR}"
BBFILES ?= ""

BBLAYERS ?= " \
  /home/serhii/Inango_TestTask/Linux_Kernel_Module/poky/meta \
  /home/serhii/Inango_TestTask/Linux_Kernel_Module/poky/meta-poky \
  /home/serhii/Inango_TestTask/Linux_Kernel_Module/poky/meta-yocto-bsp \
  "
```

## Linux_Kernel_Module/src/conf/layer.conf
```bitbake
# We have a conf and classes directory, add to BBPATH
BBPATH .= ":${LAYERDIR}"

# We have recipes-* directories, add to BBFILES
BBFILES += "${LAYERDIR}/recipes/*/*.bb \
            ${LAYERDIR}/recipes/*/*.bbappend"

BBFILE_COLLECTIONS += "workspacelayer"
BBFILE_PATTERN_workspacelayer = "^${LAYERDIR}/"
BBFILE_PRIORITY_workspacelayer = "6"
LAYERVERSION_workspacelayer = "1"
LAYERSERIES_COMPAT_workspacelayer = "scarthgap"
```
